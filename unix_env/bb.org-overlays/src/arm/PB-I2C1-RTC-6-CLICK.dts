/*
 * Copyright (C) 2017 Robert Nelson <robertcnelson@gmail.com>
 *
 * This program is free software; you can redistribute it and/or modify
 * it under the terms of the GNU General Public License version 2 as
 * published by the Free Software Foundation.
 */
/dts-v1/;
/plugin/;

#include <dt-bindings/board/am335x-bbw-bbb-base.h>
#include <dt-bindings/gpio/gpio.h>
#include <dt-bindings/pinctrl/am33xx.h>

/ {
	fragment@0 {
		target-path="/";
		__overlay__ {

			aliases {
				rtc0 = "/ocp/i2c@4802a000/mcp7941x@6f";
				rtc1 = "/ocp/rtc@44e3e000";
			};
		};
	};

	fragment@1 {
		target = <&i2c1>;
		__overlay__ {
			status = "okay";

			#address-cells = <1>;
			#size-cells = <0>;

			mcp7941x@6f {
				compatible = "microchip,mcp7941x";
				reg = <0x6f>;
			};
		};
	};
};

