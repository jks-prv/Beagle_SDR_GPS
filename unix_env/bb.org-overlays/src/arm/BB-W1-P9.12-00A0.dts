/*
 * Copyright (C) 2015 Robert Nelson <robertcnelson@gmail.com>
 *
 * Virtual cape for onewire on connector pin P9.12
 *
 * This program is free software; you can redistribute it and/or modify
 * it under the terms of the GNU General Public License version 2 as
 * published by the Free Software Foundation.
 */
/dts-v1/;
/plugin/;

#include <dt-bindings/board/am335x-bbw-bbb-base.h>
#include <dt-bindings/gpio/gpio.h>
#include <dt-bindings/pinctrl/am33xx.h>

/ {
	compatible = "ti,beaglebone", "ti,beaglebone-black", "ti,beaglebone-green";

	/* identification */
	part-number = "BB-W1-P9.12";
	version = "00A0";

	/* state the resources this cape uses */
	exclusive-use =
		/* the pin header uses */
		"P9.12";

	fragment@0 {
		target = <&am33xx_pinmux>;
		__overlay__ {

			dallas_w1_pins: pinmux_dallas_w1_pins {
				pinctrl-single,pins = < 
					BONE_P9_12 0x37
				>;
			};
		};
	};

	fragment@1 {
		target-path="/";
		__overlay__ {

			onewire {
				status = "okay";
				pinctrl-names = "default";
				pinctrl-0 = <&dallas_w1_pins>;

				compatible = "w1-gpio";
				gpios = <&gpio1 28 GPIO_ACTIVE_HIGH>;
			};
		};
	};
};
