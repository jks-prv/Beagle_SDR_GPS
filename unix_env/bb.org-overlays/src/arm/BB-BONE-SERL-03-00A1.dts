/*
 * Copyright (C) 2013 CircuitCo
 *
 * RS232 cape for the default configuration on UART2
 * Use one of the BB-UART* examples if you modify the default
 * configuration.
 *
 * This program is free software; you can redistribute it and/or modify
 * it under the terms of the GNU General Public License version 2 as
 * published by the Free Software Foundation.
 */
/dts-v1/;
/plugin/;

#include <dt-bindings/board/am335x-bbw-bbb-base.h>
#include <dt-bindings/pinctrl/am33xx.h>

/ {
	compatible = "ti,beaglebone", "ti,beaglebone-black", "ti,beaglebone-green";

	/* identification */
	part-number = "BB-BONE-SERL-03";
	version = "00A1";

	/* state the resources this cape uses */
	exclusive-use =
		/* the pin header uses */
		"P9.21",	/* uart2_txd */
		"P9.22",	/* uart2_rxd */
		/* the hardware ip uses */
		"uart2";

	fragment@0 {
		target = <&am33xx_pinmux>;
		__overlay__ {
			bb_uart2_pins: pinmux_bb_uart2_pins {
				pinctrl-single,pins = <
					BONE_P9_21 (PIN_OUTPUT_PULLDOWN | MUX_MODE1) /* spi0_d0.uart2_txd */
					BONE_P9_22 (PIN_INPUT_PULLUP | MUX_MODE1) /* spi0_sclk.uart2_rxd */
				>;
			};
		};
	};

	fragment@1 {
		target = <&uart2>;
		__overlay__ {
			status = "okay";
			pinctrl-names = "default";
			pinctrl-0 = <&bb_uart2_pins>;
		};
	};
};
