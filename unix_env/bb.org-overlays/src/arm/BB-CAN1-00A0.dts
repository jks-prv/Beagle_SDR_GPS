/*
 * Copyright (C) 2015 Robert Nelson <robertcnelson@gmail.com>
 *
 * Virtual cape for CAN1 on connector pins P9.24 P9.26
 *
 * This program is free software; you can redistribute it and/or modify
 * it under the terms of the GNU General Public License version 2 as
 * published by the Free Software Foundation.
 */
/dts-v1/;
/plugin/;

#include <dt-bindings/board/am335x-bbw-bbb-base.h>
#include <dt-bindings/pinctrl/am33xx.h>

/ {
	compatible = "ti,beaglebone", "ti,beaglebone-black", "ti,beaglebone-green";

	/* identification */
	part-number = "BB-CAN1";
	version = "00A0";

	/* state the resources this cape uses */
	exclusive-use =
		/* the pin header uses */
		"P9.24",	/* can1_rx */
		"P9.26",	/* can1_tx */
		/* the hardware ip uses */
		"dcan1";

	fragment@0 {
		target = <&am33xx_pinmux>;
		__overlay__ {
			bb_dcan1_pins: pinmux_dcan1_pins {
				pinctrl-single,pins = <
					BONE_P9_24 (PIN_INPUT_PULLUP | MUX_MODE2) /* uart1_txd.d_can1_rx */
					BONE_P9_26 (PIN_OUTPUT_PULLUP | MUX_MODE2) /* uart1_rxd.d_can1_tx */
				>;
			};
		};
	};

	fragment@1 {
		target = <&dcan1>;
		__overlay__ {
			status = "okay";
			pinctrl-names = "default";
			pinctrl-0 = <&bb_dcan1_pins>;
		};
	};
};
