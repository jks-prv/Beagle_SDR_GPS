/dts-v1/;

/ {
	compatible = "ti,beaglebone", "ti,beaglebone-black", "ti,beaglebone-green";
	part-number = "BB-SPIDEV0";
	version = "00A0";
	exclusive-use = "P9.17", "P9.18", "P9.21", "P9.22", "spi0";

	fragment@0 {
		target = <0xdeadbeef>;

		__overlay__ {

			pinmux_bb_spi0_pins {
				pinctrl-single,pins = <0x150 0x30 0x154 0x30 0x158 0x10 0x15c 0x10>;
				linux,phandle = <0x1>;
				phandle = <0x1>;
			};
		};
	};

	fragment@1 {
		target = <0xdeadbeef>;

		__overlay__ {
			#address-cells = <0x1>;
			#size-cells = <0x0>;
			status = "okay";
			pinctrl-names = "default";
			pinctrl-0 = <0x1>;
			ti,pio-mode;

			channel@0 {
				#address-cells = <0x1>;
				#size-cells = <0x0>;
				compatible = "spidev";
				reg = <0x0>;
				spi-max-frequency = <0xf42400>;
				spi-cpha;
			};

			channel@1 {
				#address-cells = <0x1>;
				#size-cells = <0x0>;
				compatible = "spidev";
				reg = <0x1>;
				spi-max-frequency = <0xf42400>;
			};
		};
	};

	__symbols__ {
		bb_spi0_pins = "/fragment@0/__overlay__/pinmux_bb_spi0_pins";
	};

	__local_fixups__ {

		fragment@1 {

			__overlay__ {
				pinctrl-0 = <0x0>;
			};
		};
	};

	__fixups__ {
		am33xx_pinmux = "/fragment@0:target:0";
		spi0 = "/fragment@1:target:0";
	};
};
