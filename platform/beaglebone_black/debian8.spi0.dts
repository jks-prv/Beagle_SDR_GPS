/dts-v1/;

/ {
	compatible = "ti,beaglebone", "ti,beaglebone-black", "ti,beaglebone-green";
	part-number = "BB-SPI0-MCP3008";
	version = "00A0";
	exclusive-use = "P9.22", "P9.21", "P9.18", "P9.17", "spi0";

	fragment@0 {
		target = <0xdeadbeef>;

		__overlay__ {

			pinmux_bb_spi0_pins {
				pinctrl-single,pins = <0x150 0x30 0x154 0x30 0x158 0x10 0x15c 0x10>;
				linux,phandle = <0x1>;
				phandle = <0x1>;
			};
		};
	};

	fragment@1 {
		target = <0xdeadbeef>;

		__overlay__ {
			#address-cells = <0x1>;
			#size-cells = <0x0>;
			pinctrl-names = "default";
			pinctrl-0 = <0x1>;
			status = "okay";
			ti,pio-mode;

			mcp3x0x@0 {
				spi-max-frequency = <0xf4240>;
				reg = <0x0>;
				compatible = "mcp3008";
			};
		};
	};

	__symbols__ {
		bb_spi0_pins = "/fragment@0/__overlay__/pinmux_bb_spi0_pins";
	};

	__local_fixups__ {

		fragment@1 {

			__overlay__ {
				pinctrl-0 = <0x0>;
			};
		};
	};

	__fixups__ {
		am33xx_pinmux = "/fragment@0:target:0";
		spi0 = "/fragment@1:target:0";
	};
};
