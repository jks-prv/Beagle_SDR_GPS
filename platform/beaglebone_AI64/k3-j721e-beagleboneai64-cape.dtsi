// SPDX-License-Identifier: GPL-2.0
/*
 * Copyright (C) 2022 BeagleBoard.org - https://beagleboard.org/
 */

bone_i2c_1: &main_i2c6 {
	pinctrl-names = "default";
    #ifdef KiwiSDR
    #else
        pinctrl-0 = <
                 &P9_18_i2c_pin /* i2c6_sda */
                 &P9_17_i2c_pin /* i2c6_scl */
                >;
    #endif
	clock-frequency = <100000>;

	symlink = "bone/i2c/1";
};

bone_i2c_2: &main_i2c2 {
	pinctrl-names = "default";
	pinctrl-0 = <
		     &P9_20_i2c_pin /* i2c2_sda */
		     &P9_19_i2c_pin /* i2c2_scl */
		    >;
	clock-frequency = <100000>;
	symlink = "bone/i2c/2";

    /* KiwiSDR cape eeprom */
    #ifdef KiwiSDR
        eeprom@54 {
            compatible = "atmel,24c32";
            reg = <0x54>;
        };
    #endif
};

bone_i2c_3: &main_i2c4 {
	pinctrl-names = "default";
    #ifdef KiwiSDR
    #else
        pinctrl-0 = <
                 &P9_26_i2c_pin /* i2c4_sda */
                 &P9_24_i2c_pin /* i2c4_scl */
                >;
    #endif
	clock-frequency = <100000>;

	symlink = "bone/i2c/3";
};
